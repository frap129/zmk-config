## config/west.yml
```yaml
manifest:
  remotes:
    - name: zmkfirmware
      url-base: https://github.com/zmkfirmware
    - name: frap129
      url-base: https://github.com/frap129
  projects:
    - name: zmk
      remote: frap129
      revision: sofle
      import: app/west.yml
  self:
    path: config
```
